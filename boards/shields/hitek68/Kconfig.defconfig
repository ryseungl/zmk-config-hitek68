## boards/shields/hitek68/Kconfig.defconfig
```kconfig
if SHIELD_HITEK68_LEFT

config ZMK_KEYBOARD_NAME
    default "Hitek68"

config ZMK_SPLIT_ROLE_CENTRAL
    default n

endif

if SHIELD_HITEK68_RIGHT

config ZMK_KEYBOARD_NAME
    default "Hitek68"

config ZMK_SPLIT_ROLE_CENTRAL
    default n

endif

if SHIELD_HITEK68_DONGLE

config ZMK_KEYBOARD_NAME
    default "Hitek68"

config ZMK_SPLIT_ROLE_CENTRAL
    default y

endif
```

## boards/shields/hitek68/Kconfig.shield
```kconfig
if SHIELD_HITEK68_LEFT || SHIELD_HITEK68_RIGHT || SHIELD_HITEK68_DONGLE

config ZMK_SPLIT
    default y

config ZMK_BLE
    default y

endif

config SHIELD_HITEK68_LEFT
    def_bool $(shields_list_contains,hitek68_left)

config SHIELD_HITEK68_RIGHT
    def_bool $(shields_list_contains,hitek68_right)

config SHIELD_HITEK68_DONGLE
    def_bool $(shields_list_contains,hitek68_dongle)

if SHIELD_HITEK68_DONGLE

config ZMK_SPLIT_BATTERY_HID_REPORT
    bool "Expose split-half battery levels over USB HID"
    default y
    help
      Adds a vendor-defined USB HID interface (Usage Page 0xFF00) on the
      dongle that reports left/right peripheral battery levels to the host.
      Requires CONFIG_ZMK_SPLIT_BLE_CENTRAL_BATTERY_LEVEL_FETCHING.

config HITEK68_SETTINGS_RELAY
    bool "Relay runtime settings from USB host to split halves over BLE"
    default y
    depends on ZMK_SPLIT_BATTERY_HID_REPORT
    help
      Extends the dongle's vendor HID interface with output reports so the
      host app can send debounce/sleep settings. The dongle relays them to
      each connected half via the Hitek68 settings GATT service.

endif

if SHIELD_HITEK68_LEFT || SHIELD_HITEK68_RIGHT

config HITEK68_RUNTIME_DEBOUNCE
    bool "Runtime-adjustable key debounce (no reflash)"
    default y
    help
      Uses the hitek68,kscan-gpio-matrix driver (a fork of ZMK's with the
      debounce config in RAM) so debounce press/release times can be changed
      at runtime and persist via Zephyr settings.

config HITEK68_RUNTIME_SLEEP
    bool "Runtime-adjustable deep-sleep timeout (no reflash)"
    default y
    help
      Replaces ZMK's compile-time idle sleep with a module-owned
      implementation whose timeout can be changed at runtime and persists
      via Zephyr settings. Disable CONFIG_ZMK_SLEEP when using this.

config HITEK68_SETTINGS_GATT
    bool "Expose runtime settings over BLE GATT"
    default y
    depends on HITEK68_RUNTIME_DEBOUNCE || HITEK68_RUNTIME_SLEEP
    help
      Defines the Hitek68 settings GATT service on split halves so the
      dongle can read/write debounce and sleep timeout over BLE.

endif
```
